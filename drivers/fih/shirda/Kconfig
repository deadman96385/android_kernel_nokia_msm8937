## drivers/fih/shirda/Kconfig
```kconfig
menu "SHARP IrDA driver"

comment "SHARP Infrared driver module configuration for Qualcomm chipset"

config SHIRDA
	bool "SHIRDA driver"
	default n

config SHIRBLASTER
	bool "SHIRBLASTER driver"
	depends on SHIRDA
	default n

config SHIRDA_CPU_HW
	string "CPU Chips & HardWare"
	default "default"
	depends on SHIRDA
	help
	Specify the configuration name for the point of diffarence hardware
	Examples:
	    MSM8926
	    MSM8974

endmenu
```
