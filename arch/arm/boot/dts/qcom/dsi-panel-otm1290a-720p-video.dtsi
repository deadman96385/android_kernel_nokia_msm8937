/* Copyright (c) 2013, The Linux Foundation. All rights reserved.
 *
 * This program is free software; you can redistribute it and/or modify
 * it under the terms of the GNU General Public License version 2 and
 * only version 2 as published by the Free Software Foundation.
 *
 * This program is distributed in the hope that it will be useful,
 * but WITHOUT ANY WARRANTY; without even the implied warranty of
 * MERCHANTABILITY or FITNESS FOR A PARTICULAR PURPOSE.  See the
 * GNU General Public License for more details.
 */

/*---------------------------------------------------------------------------
 * This file is autogenerated file using gcdb parser. Please do not edit it.
 * Update input XML file to add a new entry or update variable in this file
 * VERSION = "1.0"
 *---------------------------------------------------------------------------*/
&mdss_mdp {
	dsi_otm1290a_720p_video: qcom,mdss_dsi_otm1290a_720p_video {
		qcom,mdss-dsi-panel-name = "otm1290a 720p video mode dsi panel";
		qcom,mdss-dsi-panel-controller = <&mdss_dsi0>;
		qcom,mdss-dsi-panel-type = "dsi_video_mode";
		qcom,mdss-dsi-panel-destination = "display_1";
		qcom,mdss-dsi-panel-framerate = <60>;
		qcom,mdss-dsi-virtual-channel-id = <0>;
		qcom,mdss-dsi-stream = <0>;
		qcom,mdss-dsi-panel-width = <720>;
		qcom,mdss-dsi-panel-height = <1280>;
		qcom,mdss-dsi-h-front-porch = <44>;
		qcom,mdss-dsi-h-back-porch = <42>;
		qcom,mdss-dsi-h-pulse-width = <2>;
		qcom,mdss-dsi-h-sync-skew = <0>;
		qcom,mdss-dsi-v-back-porch = <14>;
		qcom,mdss-dsi-v-front-porch = <16>;
		qcom,mdss-dsi-v-pulse-width = <2>;
		qcom,mdss-dsi-h-left-border = <0>;
		qcom,mdss-dsi-h-right-border = <0>;
		qcom,mdss-dsi-v-top-border = <0>;
		qcom,mdss-dsi-v-bottom-border = <0>;
		qcom,mdss-dsi-bpp = <24>;
		qcom,mdss-dsi-color-order = "rgb_swap_rgb";
		qcom,mdss-dsi-underflow-color = <0xff>;
		qcom,mdss-dsi-border-color = <0>;
		qcom,mdss-dsi-on-command = [39 01 00 00 00 00 02 00 00
39 01 00 00 00 00 04 ff 12 90 01
39 01 00 00 00 00 02 00 80
39 01 00 00 00 00 03 ff 12 90
39 01 00 00 00 00 02 00 90
39 01 00 00 00 00 02 ff b0
39 01 00 00 00 00 02 00 80
39 01 00 00 00 00 0a c0 00 8f 00 10 00 11 01 04 03
39 01 00 00 00 00 02 00 90
39 01 00 00 00 00 02 C1 03
39 01 00 00 00 00 02 00 ac
39 01 00 00 00 00 02 c1 0c
39 01 00 00 00 00 02 00 c0
39 01 00 00 00 00 02 c0 88
39 01 00 00 00 00 02 00 a6
39 01 00 00 00 00 07 c0 00 60 00 00 00 02
39 01 00 00 00 00 02 00 81
39 01 00 00 00 00 02 b2 21
39 01 00 00 00 00 02 00 b1
39 01 00 00 00 00 02 c0 40
39 01 00 00 00 00 02 00 85
39 01 00 00 00 00 02 b0 01
39 01 00 00 00 00 02 00 95
39 01 00 00 00 00 02 b0 1b
39 01 00 00 00 00 02 00 97
39 01 00 00 00 00 02 b0 00
39 01 00 00 00 00 02 00 80
39 01 00 00 00 00 02 a4 3f
39 01 00 00 00 00 02 00 81
39 01 00 00 00 00 02 a4 02
39 01 00 00 00 00 02 00 80
39 01 00 00 00 00 02 a5 b3
39 01 00 00 00 00 02 00 a2
39 01 00 00 00 00 02 c0 00
39 01 00 00 00 00 02 00 84
39 01 00 00 00 00 06 f5 72 82 79 0b 92
39 01 00 00 00 00 02 00 86
39 01 00 00 00 00 02 a5 f0
39 01 00 00 00 00 02 00 d0
39 01 00 00 00 00 05 c0 00 00 00 00
39 01 00 00 00 00 02 00 87
39 01 00 00 00 00 03 c5 01 44
39 01 00 00 00 00 02 00 80
39 01 00 00 00 00 03 c5 db 93
39 01 00 00 00 00 02 00 83
39 01 00 00 00 00 02 c5 55
39 01 00 00 00 00 02 00 85
39 01 00 00 00 00 02 c5 12
39 01 00 00 00 00 02 00 00
39 01 00 00 00 00 03 d8 27 27
39 01 00 00 00 00 02 00 01
39 01 00 00 00 00 02 d9 7f
39 01 00 00 00 00 02 00 80
39 01 00 00 00 00 09 cb 14 14 14 14 14 14 14 14
39 01 00 00 00 00 02 00 a0
39 01 00 00 00 00 02 cb 04
39 01 00 00 00 00 02 00 80
39 01 00 00 00 00 10 cc 15 16 09 0a 0b 0c 0d 0f 11 13 00 01 00 00 00
39 01 00 00 00 00 02 00 90
39 01 00 00 00 00 10 cc 01 00 00 05 00 00 15 16 19 1a 1b 1c 0e 10 12
39 01 00 00 00 00 02 00 a0
39 01 00 00 00 00 0d cc 14 00 01 00 00 00 00 01 00 06 00 00
39 01 00 00 00 00 02 00 b0
39 01 00 00 00 00 10 cc 15 16 1c 1b 1a 19 10 0e 06 14 00 01 00 00 00
39 01 00 00 00 00 02 00 c0
39 01 00 00 00 00 10 cc 01 00 00 12 00 00 15 16 0c 0b 0a 09 0f 0d 05
39 01 00 00 00 00 02 00 d0
39 01 00 00 00 00 0d cc 13 00 01 00 00 00 00 01 00 11 00 00
39 01 00 00 00 00 02 00 e0
39 01 00 00 00 00 06 cc 00 00 00 00 00
39 01 00 00 00 00 02 00 80
39 01 00 00 00 00 07 ce 86 00 85 01 02 33
39 01 00 00 00 00 02 00 90
39 01 00 00 00 00 06 ce 84 00 83 00 01
39 01 00 00 00 00 02 00 a0
39 01 00 00 00 00 0c ce 84 04 00 82 06 3b 80 08 00 02 0a
39 01 00 00 00 00 02 00 b0
39 01 00 00 00 00 0d ce 04 00 00 05 01 06 02 00 07 03 00 00
39 01 00 00 00 00 02 00 80
39 01 00 00 00 00 0c cf 80 3f 3f 0f 00 00 00 00 00 00 00
39 01 00 00 00 00 02 00 a0
39 01 00 00 00 00 05 f3 02 3b 00 00
39 01 00 00 00 00 02 00 00
39 01 00 00 00 00 11 E1 32 4c 5b 6c 78 93 8e a3 55 42 4c 36 25 18 14 12
39 01 00 00 00 00 02 00 00
39 01 00 00 00 00 11 E2 32 4c 5b 6c 78 93 8e a3 55 42 4c 36 25 18 14 12
39 01 00 00 00 00 02 00 80
39 01 00 00 00 00 03 ff ff ff
39 01 00 00 00 00 02 00 00
39 01 00 00 00 00 04 ff ff ff ff
			39 01 00 00 00 00 02 91 80
			05 01 00 00 78 00 02 11 00
			05 01 00 00 32 00 02 29 00
			29 01 00 00 00 00 02 51 00
			29 01 00 00 00 00 02 53 24];
		qcom,mdss-dsi-off-command = [05 01 00 00 32 00 02 28 00
					05 01 00 00 78 00 02 10 00];
		qcom,mdss-dsi-on-command-state = "dsi_lp_mode";
		qcom,mdss-dsi-off-command-state = "dsi_hs_mode";
		qcom,mdss-dsi-h-sync-pulse = <1>;
		qcom,mdss-dsi-traffic-mode = "burst_mode";
		qcom,mdss-dsi-lane-map = "lane_map_0123";
		qcom,mdss-dsi-bllp-eof-power-mode;
		qcom,mdss-dsi-bllp-power-mode;
		qcom,mdss-dsi-lane-0-state;
		qcom,mdss-dsi-lane-1-state;
		qcom,mdss-dsi-lane-2-state;
		qcom,mdss-dsi-lane-3-state;
		qcom,mdss-dsi-panel-timings = [75 18 10 00 3A 3E 14 1A 13 03 04 00];
		qcom,mdss-dsi-t-clk-post = <0x04>;
		qcom,mdss-dsi-t-clk-pre = <0x19>;
		qcom,mdss-dsi-bl-min-level = <1>;
		qcom,mdss-dsi-bl-max-level = <4095>;
		qcom,mdss-dsi-dma-trigger = "trigger_sw";
		qcom,mdss-dsi-mdp-trigger = "none";
		qcom,mdss-dsi-bl-pmic-control-type = "bl_ctrl_wled";
		qcom,mdss-dsi-reset-sequence = <1 20>, <0 20>, <1 20>;
		qcom,cont-splash-enabled;
		qcom,esd-check-enabled;
		qcom,mdss-dsi-panel-status-command = [06 01 00 01 05 00 01 0A];
		qcom,mdss-dsi-panel-status-command-mode = "dsi_hs_mode";
		qcom,mdss-dsi-panel-status-check-mode = "reg_read";
		qcom,mdss-dsi-panel-status-read-length = <1>;
		qcom,mdss-dsi-panel-status-value = <0x9C>;
		qcom,mdss-dsi-panel-max-error-count = <3>;
	};
};
